## examples/sensor_net/main/Kconfig.projbuild
```kconfig
# Gateway camera and audio options removed; no camera or audio code in this build.

menu "Sensor Net Gateway"

config SENSOR_NET_HALOW_ENABLED
    bool "Enable HaLow backhaul by default"
    default y
    help
        When enabled, the gateway uses HaLow for backhaul by default.
        When disabled, the gateway uses 2.4 GHz Wi-Fi only by default.
        This can be changed at runtime via the Settings web UI (http://192.168.4.1/settings).

config SENSOR_NET_PERFORMANCE_MODE
    bool "Performance mode: settings page and network only"
    default n
    help
        When enabled, only the settings web page and network components
        (HaLow, WiFi STA, 2.4 GHz AP) are built. Dashboard, ESP-NOW,
        iperf3, sensor gateway, time sync, and weather are excluded
        (not just hidden) to reduce RAM and CPU usage.

config SENSOR_NET_HOMEKIT
    bool "Enable Apple HomeKit bridge"
    default n
    help
        Expose sensor nodes as HomeKit accessories (Temperature, Humidity, Motion)
        via the esp-homekit-sdk. The gateway appears as one Bridge in the Home app.
        Requires esp-homekit-sdk cloned in examples/sensor_net/esp-homekit-sdk.

config SENSOR_NET_HOMEKIT_SETUP_CODE
    string "HomeKit setup code (xxx-xx-xxx)"
    default "111-22-333"
    depends on SENSOR_NET_HOMEKIT
    help
        Setup code for pairing in the Home app. For production use factory NVS.

config SENSOR_NET_HOMEKIT_SETUP_ID
    string "HomeKit setup ID (4 characters)"
    default "SN01"
    depends on SENSOR_NET_HOMEKIT
    help
        Setup ID for pairing (e.g. shown in QR code).

endmenu
```

## examples/sensor_net/sdkconfig.defaults
```kconfig
CONFIG_LWIP_NETIF_STATUS_CALLBACK=y
CONFIG_LWIP_IP_FORWARD=y
CONFIG_LWIP_IPV4_NAPT=y
# Required for NAPT to work on ESP (see lwip/port/include/lwipopts.h)
CONFIG_LWIP_L2_TO_L3_COPY=y
CONFIG_LWIP_IPV6_AUTOCONFIG=y
CONFIG_LWIP_IPV6_DHCP6=y

CONFIG_FREERTOS_HZ=1000
CONFIG_PM_ENABLE=n
CONFIG_FREERTOS_USE_TICKLESS_IDLE=n

# We increase this from its default priority of 1 so that the FreeRTOS timer service will be a
# higher priority than any of the thread created by MMOSAL (i.e. higher priority than
# MMOSAL_TASK_PRI_HIGH). See "Timers" section in the Morse Micro Operating System Abstraction Layer
# (mmosal) API docs.
CONFIG_FREERTOS_TIMER_TASK_PRIORITY=10

CONFIG_IDF_TARGET="esp32s3"

# SPI in IRAM for lower latency (HaLow SPI to MM6108)
CONFIG_SPI_MASTER_IN_IRAM=y
CONFIG_SPI_MASTER_ISR_IN_IRAM=y
CONFIG_SPI_SLAVE_IN_IRAM=n
CONFIG_SPI_SLAVE_ISR_IN_IRAM=n

CONFIG_LWIP_IRAM_OPTIMIZATION=y
CONFIG_LWIP_MAX_SOCKETS=16
CONFIG_LWIP_TCP_MSS=1460
# TCP window/buffer: helps both directions; recv/tcpip mbox give NAPT headroom for download bursts.
CONFIG_LWIP_TCP_SND_BUF_DEFAULT=120000
CONFIG_LWIP_TCP_WND_DEFAULT=120000
CONFIG_LWIP_TCP_RECVMBOX_SIZE=48
CONFIG_LWIP_TCPIP_RECVMBOX_SIZE=96
CONFIG_LWIP_UDP_RECVMBOX_SIZE=24

# Use 8MB flash with custom partitions
CONFIG_ESPTOOLPY_FLASHSIZE_8MB=y
CONFIG_ESPTOOLPY_FLASHSIZE="8MB"
CONFIG_PARTITION_TABLE_CUSTOM=y
CONFIG_PARTITION_TABLE_CUSTOM_FILENAME="partitions.csv"
CONFIG_PARTITION_TABLE_FILENAME="partitions.csv"

CONFIG_MBEDTLS_NIST_KW_C=y

# 8MB PSRAM (octal SPI, auto-detect, boot-init).
# malloc() uses PSRAM for allocs > 512 B; internal RAM reserved for DMA/small allocs.
CONFIG_ESP32S3_SPIRAM_SUPPORT=y
CONFIG_SPIRAM=y
# CONFIG_SPIRAM_MODE_QUAD is not set
CONFIG_SPIRAM_MODE_OCT=y
CONFIG_SPIRAM_TYPE_AUTO=y
CONFIG_SPIRAM_ALLOW_STACK_EXTERNAL_MEMORY=y
CONFIG_SPIRAM_CLK_IO=30
CONFIG_SPIRAM_CS_IO=26
CONFIG_SPIRAM_FETCH_INSTRUCTIONS=y
CONFIG_SPIRAM_RODATA=y
CONFIG_SPIRAM_SPEED_80M=y
CONFIG_SPIRAM_SPEED=80
CONFIG_SPIRAM_BOOT_INIT=y
# CONFIG_SPIRAM_USE_MEMMAP is not set
# CONFIG_SPIRAM_USE_CAPS_ALLOC is not set
CONFIG_SPIRAM_USE_MALLOC=y
CONFIG_SPIRAM_MALLOC_ALWAYSINTERNAL=512
CONFIG_SPIRAM_TRY_ALLOCATE_WIFI_LWIP=y
CONFIG_SPIRAM_MALLOC_RESERVE_INTERNAL=81920
CONFIG_SPIRAM_ALLOW_BSS_SEG_EXTERNAL_MEMORY=y

# App main task stack (matches TASKS_AND_PSRAM.md; large enough for init + packet structs)
CONFIG_ESP_MAIN_TASK_STACK_SIZE=20480
CONFIG_MAIN_TASK_STACK_SIZE=20480

# WiFi task stack (AP+STA+NAPT can overflow default; avoid "stack overflow in task wifi")
# If your ESP-IDF has this option (Component config -> Wi-Fi), it will be applied.
# Override in code (wifi_task_stack_override.c) is 16384; keep in sync if you change it.
CONFIG_ESP_WIFI_TASK_STACK_SIZE=16384

# Allow modern browsers' long request headers (Sec-CH-UA, etc.)
CONFIG_HTTPD_MAX_REQ_HDR_LEN=2048
CONFIG_HTTPD_MAX_URI_LEN=512
```

## examples/sensor_net/sdkconfig.defaults.esp32s3
```kconfig
#
# ESP32S3-specific
#
CONFIG_ESP32S3_INSTRUCTION_CACHE_32KB=y

# PSRAM enable (S3-specific gate; full config is in sdkconfig.defaults)
CONFIG_ESP32S3_SPIRAM_SUPPORT=y
```

## examples/sensor_net/sensor_unit/main/Kconfig.projbuild
```kconfig
# Sensor unit: optional camera (Xiao ESP32-S3-Sense) for MJPEG stream to gateway dashboard
config SENSOR_CAMERA_ENABLE
    bool "Enable camera stream (/stream for gateway dashboard)"
    default y
    help
        When enabled, initializes the OV2640 camera on Xiao ESP32-S3-Sense
        and serves MJPEG at http://<sensor-ip>/stream. Add this URL in the
        gateway dashboard Cameras tab to view the stream.

# GPIO for status LED (Blink button on gateway dashboard). -1 to disable.
config SENSOR_LED_GPIO
    int "LED GPIO for blink command (e.g. 21 for ESP32-S3 built-in)"
    default 21
    range -1 48
    help
        GPIO number for the node LED. Gateway dashboard "Blink" sends
        ESP-NOW command to blink this LED. Set to -1 to disable.

# Motion sensor input (RCWL-0516).
config SENSOR_MOTION_GPIO
    int "Motion sensor GPIO (RCWL-0516 OUT). -1 to disable"
    default 0
    range -1 48
    help
        GPIO number for the motion sensor OUT pin. Set to -1 to disable.

# BME680 I2C wiring (D4/D5 in ESP-Motion example).
config SENSOR_BME_I2C_PORT
    int "BME680 I2C port"
    default 0
    range 0 1
    help
        ESP-IDF I2C port used for BME680.

config SENSOR_BME_I2C_SDA_GPIO
    int "BME680 I2C SDA GPIO. -1 to disable"
    default 19
    range -1 48
    help
        GPIO number for BME680 SDA. Set to -1 to disable BME680.

config SENSOR_BME_I2C_SCL_GPIO
    int "BME680 I2C SCL GPIO. -1 to disable"
    default 20
    range -1 48
    help
        GPIO number for BME680 SCL. Set to -1 to disable BME680.

config SENSOR_BME_I2C_FREQ_HZ
    int "BME680 I2C frequency (Hz)"
    default 100000
    range 10000 1000000
    help
        I2C clock frequency for BME680.

config SENSOR_BME_I2C_ADDR
    int "BME680 I2C address (0x76 or 0x77)"
    default 0x77
    range 0x76 0x77
    help
        I2C address for the BME680 sensor.
```

## examples/sensor_net/sensor_unit/sdkconfig.defaults
```kconfig
CONFIG_IDF_TARGET="esp32s3"
CONFIG_ESPTOOLPY_FLASHSIZE_8MB=y
CONFIG_LOG_BUFFER_SIZE=4096
CONFIG_ESP_SYSTEM_USE_EH_FRAME=y
CONFIG_LWIP_NETIF_STATUS_CALLBACK=y
CONFIG_ESP_TASK_WDT_TIMEOUT_S=30
CONFIG_ESP_INT_WDT_TIMEOUT_MS=1000

# PSRAM required for camera (Xiao ESP32-S3-Sense has 8MB PSRAM)
CONFIG_ESP32S3_SPIRAM_SUPPORT=y
CONFIG_ESP32S3_DATA_CACHE_64KB=y
CONFIG_ESP32S3_INSTRUCTION_CACHE_16KB=y

# BLE disabled
CONFIG_BT_ENABLED=n
CONFIG_BT_CONTROLLER_ENABLED=n
CONFIG_BT_BLE_ENABLED=n
CONFIG_BT_BLUEDROID_ENABLED=n
```
